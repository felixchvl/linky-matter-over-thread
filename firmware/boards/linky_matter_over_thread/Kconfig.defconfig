## firmware/boards/linky_matter_over_thread/Kconfig.defconfig
```kconfig
if BOARD_LINKY_MATTER_OVER_THREAD

config HW_STACK_PROTECTION
	default ARCH_HAS_STACK_PROTECTION

endif # BOARD_LINKY_MATTER_OVER_THREAD
```

## firmware/boards/linky_matter_over_thread/Kconfig.linky_matter_over_thread
```kconfig
# SPDX-License-Identifier: Apache-2.0

config BOARD_LINKY_MATTER_OVER_THREAD
	select SOC_NRF52840_QIAA
```

## firmware/boards/linky_matter_over_thread/board.yml
```yaml
# SPDX-License-Identifier: Apache-2.0

board:
  name: linky_matter_over_thread
  full_name: linky-matter-over-thread
  socs:
  - name: nrf52840
```
